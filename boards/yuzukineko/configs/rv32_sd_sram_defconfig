## boards/yuzukineko/configs/rv32_sd_sram_defconfig
```kconfig
# SPDX-License-Identifier: GPL-2.0+
# SD card boot: MMC + FatFS only, no SPI NOR stack, no carrier peripherals
CONFIG_ARCH_RISCV32=y
CONFIG_ARCH_CPU_C907=y
CONFIG_ARCH_ICACHE=y
CONFIG_BACKTRACE_MIN=y
CONFIG_DRIVER_CLK=y
CONFIG_DRIVER_GPIO_V2=y
CONFIG_DRIVER_MMC=y
CONFIG_DRIVER_MMC_LOG_ERROR=y
CONFIG_DRIVER_PSRAM=y
CONFIG_DRIVER_SERIAL=y
CONFIG_DRIVER_SID=y
CONFIG_DRIVER_SOC=y
CONFIG_FATFS_LFN_HEAP=y
CONFIG_BOARD_YUZUKINEKO=y
CONFIG_SYS_BOARD="yuzukineko"
CONFIG_SPL_BIN_TEXT_BASE=0x00020000
CONFIG_SPL_BIN_MAX_SIZE=0x10000
CONFIG_SPL_FEL_TEXT_BASE=0x00020000
CONFIG_SPL_FEL_MAX_SIZE=0x10000
CONFIG_BUILD_RELEASE=y
CONFIG_OPTIMIZE_FOR_SIZE=y
CONFIG_APP_SRAM=y
```
